## CMakeLists.txt
```
# SPDX-License-Identifier: Apache-2.0

cmake_minimum_required(VERSION 3.20.0)
find_package(Zephyr REQUIRED HINTS $ENV{ZEPHYR_BASE})
project(tcp_sample)

add_subdirectory(src/slip)
add_subdirectory(src/dfu_lib)

FILE(GLOB app_sources src/*.c)
target_sources(app PRIVATE ${app_sources})

include(${ZEPHYR_BASE}/samples/net/common/common.cmake)
```

## Kconfig
```
#
# Copyright (c) 2020 Nordic Semiconductor ASA
#
# SPDX-License-Identifier: LicenseRef-Nordic-5-Clause
#

menu "TCP Sample Settings"

config FTP_DOWNLOAD_HOST
	string "Application update host name"
	default "ftp.dlptest.com"
	help
	  Host part of URL to application update binary. For example
	  if the file is stored in ftp://foo.bar/update.bin the value
	  of this configuration should be 'ftp://foo.bar/update.bin'

config FTP_DOWNLOAD_PORT
	int "FTP server control port"
	default 21
	help
	  server port for the ftp control communication. Default is 21 .
	  if the server is using a different port in passive mode, please specify it here.  

config FTP_DOWNLOAD_USER
	string "FTP server user name"
	default "dlpuser"	

config FTP_DOWNLOAD_PASSWORD
	string "FTP server password"
	default "rNrKYTX9g7z3RgJRmxWuGHbeu"

config TCP_DATA_UPLOAD_MAX_SIZE_BYTES
	int "Max number of bytes transmitted to the server"
	default 512

config TCP_DATA_UPLOAD_FREQUENCY_SECONDS
	int "How often data is transmitted to the server"
	default 900

config TCP_DATA_UPLOAD_ITERATIONS
	int "Number of data transmissions to the server before shutdown"
	range -1 2147483647
	default -1
	help
	  Number of data transmissions to the server before shutdown.
	  Set to -1 to transmit indefinitely.

config TCP_SERVER_ADDRESS_STATIC
	string "TCP server IP address"
	default "8.8.8.8"

config TCP_SERVER_PORT
	int "TCP server port number"
	default "2469"

config TCP_POLL_TIME
	int "Poll time-out in seconds for TCP connection"
	default "60"

config TCP_PSM_ENABLE
	bool "Enable LTE Power Saving Mode (PSM)"
	default y
	select LTE_PSM_REQ

config TCP_EDRX_ENABLE
	bool "Enable LTE enhanced Discontinuous Reception (eDRX)"
	select LTE_EDRX_REQ

config TCP_RAI_ENABLE
	bool "Enable LTE Release Assistance Indication (RAI)"
	default y
	select LTE_RAI_REQ

if TCP_RAI_ENABLE

choice TCP_RAI_INDICATION
	prompt "RAI indication to set for TCP transmission"
	default TCP_RAI_LAST

config TCP_RAI_NO_DATA
	bool "Indicates that there will be no upcoming data transmission anymore"

config TCP_RAI_LAST
	bool "Indicates that the next transmission will be the last one for some time"

config TCP_RAI_ONGOING
	bool "Indicates that the client expects to use the socket more after the next transmission"

endchoice

endif # UDP_RAI_ENABLE

endmenu

module = TCP
module-str = TCP sample
source "${ZEPHYR_BASE}/subsys/logging/Kconfig.template.log_config"

menu "Zephyr Kernel"
source "Kconfig.zephyr"
endmenu
```

## sysbuild.conf
```
#
# Copyright (c) 2023 Nordic Semiconductor
#
# SPDX-License-Identifier: LicenseRef-Nordic-5-Clause
#

SB_CONFIG_BOOTLOADER_MCUBOOT=y
SB_CONFIG_BOOT_SIGNATURE_TYPE_ECDSA_P256=y
# SB_CONFIG_MCUBOOT_MODE_OVERWRITE_ONLY=y
# SB_CONFIG_MCUBOOT_UPDATEABLE_IMAGES=1
# SB_CONFIG_MCUBOOT_COMPRESSED_IMAGE_SUPPORT=y
```

## prj.conf
```kconfig
# General config
CONFIG_REQUIRES_FULL_LIBC=y
# Heap and stacks
CONFIG_HEAP_MEM_POOL_SIZE=10240
CONFIG_MAIN_STACK_SIZE=4096
CONFIG_SYSTEM_WORKQUEUE_STACK_SIZE=15360

# Default app to debug logging
CONFIG_LOG=y
CONFIG_TCP_LOG_LEVEL_DBG=y
CONFIG_LOG_MODE_MINIMAL=n


# Networking config
CONFIG_NETWORKING=y
CONFIG_NET_IPV4=y
CONFIG_NET_IPV6=n
CONFIG_NET_TCP=y
CONFIG_NET_SOCKETS=y
# CONFIG_NET_SOCKETS_POLL_MAX=5

CONFIG_POSIX_API=y

# Network driver config
CONFIG_TEST_RANDOM_GENERATOR=y


# UART interface
CONFIG_SERIAL=y
CONFIG_UART_USE_RUNTIME_CONFIGURE=y
CONFIG_UART_ASYNC_API=y
CONFIG_NRFX_TIMER2=y
CONFIG_RING_BUFFER=y

# Image manager
CONFIG_IMG_MANAGER=y
CONFIG_FLASH=y
CONFIG_FLASH_MAP=y
CONFIG_STREAM_FLASH=y
CONFIG_IMG_ERASE_PROGRESSIVELY=y


# mcuboot
CONFIG_BOOTLOADER_MCUBOOT=y
CONFIG_MCUBOOT_IMG_MANAGER=y

#application
CONFIG_TCP_DATA_UPLOAD_FREQUENCY_SECONDS=30
CONFIG_TCP_DATA_UPLOAD_ITERATIONS=100
CONFIG_TCP_POLL_TIME=5

# my test server
CONFIG_TCP_SERVER_ADDRESS_STATIC="47.99.117.153"
CONFIG_TCP_SERVER_PORT=32769

# custom server
# CONFIG_TCP_SERVER_ADDRESS_STATIC="34.94.214.133"
# CONFIG_TCP_SERVER_PORT=8089

## Enable required LTE link control modules
CONFIG_LTE_LC_EDRX_MODULE=y
CONFIG_LTE_LC_PSM_MODULE=y
CONFIG_LTE_LC_RAI_MODULE=y

## enable ftp client library
CONFIG_FTP_CLIENT=y
CONFIG_FTP_CLIENT_KEEPALIVE_TIME=200
CONFIG_FTP_CLIENT_LISTEN_TIME=20
# CONFIG_NET_SOCKETS_CONNECT_TIMEOUT=60000

CONFIG_FTP_DOWNLOAD_HOST="113.87.90.249"
# CONFIG_FTP_DOWNLOAD_HOST="jesse.synology.me"
CONFIG_FTP_DOWNLOAD_USER="nordic"  
CONFIG_FTP_DOWNLOAD_PASSWORD="28058888"


CONFIG_FTP_CLIENT_LOG_LEVEL_DBG=y

# # FOTA library
# CONFIG_FOTA_DOWNLOAD=y
# CONFIG_FOTA_DOWNLOAD_EXTERNAL_DL=y
```

## boards/nrf9151dk_nrf9151_ns.overlay
```dts
/*
 * Copyright (c) 2024 Nordic Semiconductor ASA
 *
 * SPDX-License-Identifier: LicenseRef-Nordic-5-Clause
 */
&uart0 {
	status = "okay";
	hw-flow-control;
};

// &uart2 {
// 	current-speed = <115200>;
// 	status = "okay";
// 	pinctrl-0 = <&uart2_default_alt>; /* <&interface_to_nrf52840 1 0> */
// 	pinctrl-1 = <&uart2_sleep_alt>; /* <&interface_to_nrf52840 0 0> */
// 	pinctrl-names = "default", "sleep";
// };


// &pinctrl {
// 	uart2_default_alt: uart2_default_alt {
// 		group1 {
// 			psels = <NRF_PSEL(UART_RX, 0, 11)>;
// 			bias-pull-up;
// 		};
// 		group2 {
// 			psels = <NRF_PSEL(UART_TX, 0, 10)>,
// 				<NRF_PSEL(UART_RTS, 0, 12)>,
// 				<NRF_PSEL(UART_CTS, 0, 13)>;
// 		};
// 	};

// 	uart2_sleep_alt: uart2_sleep_alt {
// 		group1 {
// 			psels = <NRF_PSEL(UART_TX, 0, 10)>,
// 				<NRF_PSEL(UART_RX, 0, 11)>,
// 				<NRF_PSEL(UART_RTS, 0, 12)>,
// 				<NRF_PSEL(UART_CTS, 0, 13)>;
// 			low-power-enable;
// 		};
// 	};
// };


// &pinctrl {
// 	uart2_default_alt: uart2_default_alt {
// 		group1 {
// 			psels = <NRF_PSEL(UART_RX, 0, 11)>,
// 				<NRF_PSEL(UART_TX, 0, 10)>;
// 		};
// 	};

// 	uart2_sleep_alt: uart2_sleep_alt {
// 		group1 {
// 			psels = <NRF_PSEL(UART_RX, 0, 11)>,
// 				<NRF_PSEL(UART_TX, 0, 10)>;
// 			low-power-enable;
// 		};
// 	};
// };






//  / {
// 	sensor_sim: sensor-sim {
// 		compatible = "nordic,sensor-sim";
// 		status = "okay";
// 		acc-signal = "wave";
// 	};

// 	measure {
// 		compatible = "nordic,nrf-pinctrl";
// 		en {
// 			compatible = "gpio-leds";
// 			measure_en: measure_en {
// 				gpios = <&gpio0 16 0x0>;
// 				label = "measure_en";
// 			};
// 		};
// 		signal {
// 			compatible = "gpio-keys";
// 			signal1: signal_1 {
// 				// gpios = <&gpio0 13 0x1>;			//for 9160DK
// 				gpios = <&gpio0 6 0x1>;				//for 9151dk
// 				label = "signal_1";
// 			};
// 			signal2: signal_2 {
// 				// gpios = <&gpio0 15 0x1>;			//for 9160DK
// 				gpios = <&gpio0 7 0x1>;				//for 9151dk
// 				label = "signal_2";
// 			};
// 		};
// 	};
// };


// &gpio0 {
// 	status = "okay";
// 	sense-edge-mask = < 0x4040 >;
//  };



// &led0 {
// 	gpios = <&gpio0 2 0>;
// };




/* External flash device is disabled by default */
&gd25wb256 {
	status = "okay";
};
```

## src/main.c
```c
/*
 * Copyright (c) 2020 Nordic Semiconductor ASA
 *
 * SPDX-License-Identifier: LicenseRef-Nordic-5-Clause
 */

#include <stdio.h>
#include <zephyr/kernel.h>
#include <zephyr/net/socket.h>
#include <zephyr/drivers/uart.h>
#include <modem/lte_lc.h>
#include <modem/nrf_modem_lib.h>
#include <nrf_modem_at.h>

#include "app.h"
#include "upgrade_app.h"

#define FW_VERSION			"1.0.5"


K_SEM_DEFINE(lte_connected_sem, 0, 1);
K_SEM_DEFINE(modem_shutdown_sem, 0, 1);


/** Below code can be work as a timer */
#if 0

static struct k_work_delayable socket_transmission_work;
static int data_upload_iterations = CONFIG_TCP_DATA_UPLOAD_ITERATIONS;

static void socket_transmission_work_fn(struct k_work *work)
{
	printk("socket_transmission_work_fn[%d] been triggeded at %lld,\r\n ",data_upload_iterations,k_ticks_to_ms_floor64(k_uptime_ticks()));

	/* Transmit a limited number of times and then shutdown. */
	if (data_upload_iterations > 0) {
		data_upload_iterations--;
	} else if (data_upload_iterations == 0) {
		k_sem_give(&modem_shutdown_sem);
		/* No need to schedule work if we're shutting down. */
		return;
	}

	/* Schedule work if we're either transmitting indefinitely or
	 * there are more iterations left.
	 */
	k_work_schedule(&socket_transmission_work,
			K_SECONDS(CONFIG_TCP_DATA_UPLOAD_FREQUENCY_SECONDS));
}


static void work_init(void)
{
	k_work_init_delayable(&socket_transmission_work, socket_transmission_work_fn);
}

#endif

static void lte_handler(const struct lte_lc_evt *const evt)
{
	switch (evt->type) {
	case LTE_LC_EVT_NW_REG_STATUS:
		if ((evt->nw_reg_status != LTE_LC_NW_REG_REGISTERED_HOME) &&
		    (evt->nw_reg_status != LTE_LC_NW_REG_REGISTERED_ROAMING)) {
			break;
		}

		printk("Network registration status: %s\n",
		       evt->nw_reg_status == LTE_LC_NW_REG_REGISTERED_HOME ?
		       "Connected - home" : "Connected - roaming");
		k_sem_give(&lte_connected_sem);

		// k_work_schedule(&socket_transmission_work, K_SECONDS(5));
		break;
	case LTE_LC_EVT_PSM_UPDATE:
		printk("PSM parameter update: TAU: %d s, Active time: %d s\n",
		       evt->psm_cfg.tau, evt->psm_cfg.active_time);
		break;
	case LTE_LC_EVT_EDRX_UPDATE:
		printk("eDRX parameter update: eDRX: %.2f s, PTW: %.2f s\n",
		       (double)evt->edrx_cfg.edrx, (double)evt->edrx_cfg.ptw);
		break;
	case LTE_LC_EVT_RRC_UPDATE:
		printk("RRC mode: %s\n",
		       evt->rrc_mode == LTE_LC_RRC_MODE_CONNECTED ? "Connected" : "Idle\n");
		break;
	case LTE_LC_EVT_CELL_UPDATE:
		printk("LTE cell changed: Cell ID: %d, Tracking area: %d\n",
		       evt->cell.id, evt->cell.tac);
		break;
	case LTE_LC_EVT_RAI_UPDATE:
		/* RAI notification is supported by modem firmware releases >= 2.0.2 */
		printk("RAI configuration update: "
		       "Cell ID: %d, MCC: %d, MNC: %d, AS-RAI: %d, CP-RAI: %d\n",
		       evt->rai_cfg.cell_id,
		       evt->rai_cfg.mcc,
		       evt->rai_cfg.mnc,
		       evt->rai_cfg.as_rai,
		       evt->rai_cfg.cp_rai);
		break;
	default:
		break;
	}
}


static void modem_connect(void)
{
	int ret = 0;

	do {
		printk("\nConnecting to network.This may take several minutes.\n");

		ret = lte_lc_connect();
		if (ret < 0) {
			printk("Failed to establish LTE connection (%d).", ret);
			printk("Will retry in a minute.");
			lte_lc_offline();
			k_sleep(K_SECONDS(60));
		} else {
			enum lte_lc_lte_mode mode;

			lte_lc_lte_mode_get(&mode);
			if (mode == LTE_LC_LTE_MODE_NBIOT) {
				printk("Connected to NB-IoT network.\n");
			} else if (mode == LTE_LC_LTE_MODE_LTEM) {
				printk("Connected to LTE network.\n");
			} else  {
				printk("Connected to unknown network.\n");
			}
			k_sem_give(&lte_connected_sem);
		}
	} while (ret < 0);
}


int main(void)
{
	int err;

	printk("\nTCP sample has started, version is %s.\n\n",FW_VERSION);

	// work_init();

	err = nrf_modem_lib_init();
	if (err) {
		printk("Failed to initialize modem library, error: %d\n", err);
		return -1;
	}

	err = lte_lc_connect_async(lte_handler);
	if (err) {
		printk("Failed to connect to LTE network, error: %d\n", err);
		return -1;
	}

	uart_handler_init();

	ftp_client_init();
	
	while (true) 
	{
		/* Set network state to start for blocking LTE */
		if (reconnect) {
			reconnect = false;

			printk("LTE connection error. The sample will try to re-establish network connection.\n");

			/* Try to reconnect to the network. */
			err = lte_lc_offline();
			if (err < 0) {
				printk("Failed to put LTE link in offline state (%d)\n", err);
			}
			modem_connect();
		}

		/** This part code may not excute, just for low power use api */
		if( 0 == k_sem_take(&modem_shutdown_sem, K_SECONDS(2)))
		{
			/** we should suspend the tcp thread */
			// k_thread_suspend(tcp_client_tid);

			err = nrf_modem_lib_shutdown();
			if (err) {
				return -1;
			}	
		}
	}	

	return 0;
}
```

## src/app.h
```c
/*
 * Copyright (c) 2020 Nordic Semiconductor ASA
 *
 * SPDX-License-Identifier: LicenseRef-Nordic-5-Clause
 */

#ifndef __APP_H_
#define __APP_H_


typedef struct {
	uint8_t *data;
	uint16_t length;
} socket_data_t;


extern const k_tid_t tcp_client_tid; 

extern struct k_sem lte_connected_sem;

extern struct k_sem modem_shutdown_sem;

extern struct k_msgq tx_send_queue;

extern struct k_msgq rx_event_queue;

extern bool reconnect;

extern bool transfer_mode;	//transfer mode flag to indicate now uart will receive image data


extern int uart_tx_write(const uint8_t *data, size_t len);

extern void uart_send_data(uint8_t *buffer, uint16_t length);

extern void create_tcp_server_thread(void);

extern int uart_handler_init(void);


#endif /* _APP_H */
```

## src/socket_app.c
```c
/*
 * Copyright (c) 2017 Linaro Limited
 *
 * SPDX-License-Identifier: Apache-2.0
 */

#include <stdio.h>
#include <stdbool.h>
#include <errno.h>
#include <stdlib.h>
#include <zephyr/posix/fcntl.h>
#include <zephyr/net/socket.h>
#include <zephyr/kernel.h>
#include <zephyr/logging/log.h>
LOG_MODULE_REGISTER(tcp_sample, CONFIG_TCP_LOG_LEVEL);

#include "app.h"

// #ifdef CONFIG_NET_IPV6
// #define USE_IPV6
// #endif

#define TCP_THREAD_STACK_SIZE               4096
#define TCP_THREAD_PRIORITY 				5

#define SERVER_PORT 						12345
#define LISTEN_COUNT 						5

#define TX_QUEUE_COUNT						20

static k_tid_t tcp_server_tid;
static struct k_thread tcp_server;
static K_THREAD_STACK_DEFINE(tcp_server_thread_stack, TCP_THREAD_STACK_SIZE);


K_MSGQ_DEFINE(tx_send_queue, sizeof(socket_data_t), TX_QUEUE_COUNT, 4);

bool reconnect = false;


static int do_tcp_send(int sock, const uint8_t *data, int datalen)
{
	int ret = 0;
	uint32_t offset = 0;

	while (offset < datalen) {
		ret = send(sock, data + offset, datalen - offset, 0);
		if (ret < 0) {
			LOG_ERR("send() failed: %d, sent: %d", -errno, offset);
			ret = -errno;
			break;
		} else {
			// LOG_INF("Socket send data length = %d\n", ret);
			offset += ret;
		}
	}

	return ret;
}


static void receive_data_handle(uint8_t *data, uint16_t length)
{
	LOG_INF("Received %d bytes data from tcp server, data_segment:\"%s\"\n", length, data);
	uart_send_data(data, length);		//uart send back the received data with slip protocal, just for test
}


/* tcp client task */
static void tcp_client_thread(void)
{
	int ret = 0;
	struct pollfd fds[2];
	int client_socket = 0;
	uint8_t rec_buf[512] = {0};  /* For socket receive data. */
	
	k_sem_take(&lte_connected_sem, K_FOREVER);

	create_tcp_server_thread();

retry:
	LOG_WRN("LTE connected successfully, now we start tcp task!!!\n");

#if !defined(USE_IPV6)
	struct sockaddr_in server_addr = {0};

	client_socket = socket(AF_INET, SOCK_STREAM, IPPROTO_TCP);
	if (client_socket < 0) {
		LOG_ERR("error: socket(AF_INET): %d\n", errno);
		goto error_exit;
	}
	struct timeval socket_timeout = {.tv_sec = 3};

	ret = setsockopt(client_socket, SOL_SOCKET, SO_SNDTIMEO, &socket_timeout, sizeof(socket_timeout));
	if (ret) {
		LOG_ERR("setsockopt(%d) error: %d", SO_SNDTIMEO, -errno);
		ret = -errno;
		goto error_exit;
	}

	server_addr.sin_family = AF_INET;
	server_addr.sin_port = htons(CONFIG_TCP_SERVER_PORT);
	inet_pton(AF_INET, CONFIG_TCP_SERVER_ADDRESS_STATIC,&server_addr.sin_addr);
	//if we use the domain name, we should use the getaddrinfo() to get the server address
	// struct addrinfo *result;
	// struct addrinfo hints = {
	// 	.ai_family = AF_INET,
	// };
	// char ipv4_addr[NET_IPV4_ADDR_LEN];
	// ret = getaddrinfo(CONFIG_TCP_SERVER_ADDRESS_STATIC, NULL, &hints, &result);
	// if (ret) {
	// 	LOG_ERR("getaddrinfo, error: %d", ret);
	// 	goto error_exit;
	// }
	// server_addr.sin_addr.s_addr = ((struct sockaddr_in *)result->ai_addr)->sin_addr.s_addr;

	// inet_ntop(AF_INET, &server_addr.sin_addr.s_addr, ipv4_addr, sizeof(ipv4_addr));
	// LOG_INF("IPv4 Address found %s", ipv4_addr);
	// /* Free the address. */
	// freeaddrinfo(result);

	ret = connect(client_socket, (struct sockaddr *)&server_addr, sizeof(struct sockaddr_in));
	if (ret) {
		LOG_ERR("AF_INET connect() failed: %d", -errno);
		goto error_exit;
	}
#else
	struct sockaddr_in6 server_addr = {0};

	client_socket = socket(AF_INET6, SOCK_STREAM, IPPROTO_TCP);
	if (client_socket < 0) {
		printf("error: socket(AF_INET6): %d\n", errno);
		goto error_exit;
	}
	server_addr.sin6_family = AF_INET6;
	server_addr.sin6_port = htons(CONFIG_TCP_SERVER_PORT);
	inet_pton(AF_INET6, CONFIG_TCP_SERVER_ADDRESS_STATIC,&server_addr.sin6_addr);

	ret = connect(client_socket, (struct sockaddr *)&server_addr, sizeof(struct sockaddr_in6));
	if (ret) {
		LOG_ERR("AF_INET6 connect() failed: %d", -errno);
		goto error_exit;
	}
#endif
	
	fds[0].fd = client_socket;
	fds[0].events = POLLIN;

	while (1) {
		// ret = poll(fds, ARRAY_SIZE(fds), MSEC_PER_SEC * CONFIG_TCP_POLL_TIME);
		ret = poll(fds, ARRAY_SIZE(fds), 200);
		if (ret < 0) {
			LOG_WRN("poll() error: %d", ret);
			break;
		}
		else if (ret == 0) {
			/* timeout */
			// LOG_INF("TCP wait for poll event timeout at %lld.\n",k_ticks_to_ms_floor64(k_uptime_ticks()));
		}
		else{
			// LOG_DBG("[%d]sock events 0x%08x at %lld.\n", ret,fds[0].revents,k_ticks_to_ms_floor64(k_uptime_ticks()));
			if ((fds[0].revents & POLLIN) != 0) {
				/* receive data from server */
				memset(rec_buf, 0, sizeof(rec_buf));
				ret = recv(fds[0].fd, (void *)rec_buf, sizeof(rec_buf), MSG_DONTWAIT);
				if (ret < 0 && errno != EAGAIN) {
					LOG_WRN("recv() error: %d", -errno);
				} else if (ret > 0) {
					/** handle the received data from tcp server */
					receive_data_handle(rec_buf, ret);
				}
			}
			if ((fds[0].revents & POLLERR) != 0) {
				LOG_WRN("SOCK (%d): POLLERR", fds[0].fd);
				break;
			}
			if ((fds[0].revents & POLLNVAL) != 0) {
				LOG_WRN("SOCK (%d): POLLNVAL", fds[0].fd);
				break;
			}
			if ((fds[0].revents & POLLHUP) != 0) {
				/* Lose LTE connection / remote end close */
				LOG_WRN("SOCK (%d): POLLHUP", fds[0].fd);
				reconnect = true;
				k_sem_take(&lte_connected_sem, K_FOREVER);
				break;
			}
		}

		/***************** Events to send message queue. *****************************/
		{
			static uint8_t resend_count = 0;
			socket_data_t send_packet = {0};
			if (k_msgq_peek(&tx_send_queue, &send_packet) == 0)  
			{
				// LOG_INF("[%d]:%s\n",send_packet.length, send_packet.data);
				ret = do_tcp_send(client_socket, send_packet.data, send_packet.length);
				if(ret == send_packet.length)
				{
					/* send successfully, delete the queue message and free memory */
					k_msgq_get(&tx_send_queue, &send_packet, K_NO_WAIT);
					k_free(send_packet.data);
					resend_count = 0;
					LOG_DBG("Socket send [%d] successfully , the data is: \"%s\"\n",ret, send_packet.data);
				}
				else if(ret <= 0)
				{
					if(resend_count++ >= 3)
					{
						LOG_WRN("Socket has something wrong, we'd better reconnect it.\n");
						break;
					}
				}
			}
		}
	}

error_exit:
	if(client_socket)
	{
		close(client_socket);
	}
	k_sleep(K_SECONDS(3));	
	goto retry;
}


void handle_client_request(int client_sock, char *recv_buffer, int len) {
	if (strncmp(recv_buffer, "read power", strlen("read power")) == 0) {
		char *response = "power: 100W";
		send(client_sock, response, strlen(response), 0);
	} else {
		char *response = "error: unknown command";
		send(client_sock, response, strlen(response), 0);
	}
	// close(client_sock);
}


static void tcp_server_thread(void *arg1, void *arg2, void *arg3) {
    ARG_UNUSED(arg1);
    ARG_UNUSED(arg2);
    ARG_UNUSED(arg3);

    int server_sock, client_sock;
    struct sockaddr_in addr, client_addr;
    socklen_t client_addr_len = sizeof(client_addr);
    char recv_buffer[256];

    server_sock = socket(AF_INET, SOCK_STREAM, IPPROTO_TCP);
    if (server_sock < 0) {
        LOG_ERR("Failed to create server socket");
        return;
    }

    addr.sin_family = AF_INET;
    addr.sin_port = htons(SERVER_PORT);
    addr.sin_addr.s_addr = INADDR_ANY;

    if (bind(server_sock, (struct sockaddr *)&addr, sizeof(addr)) < 0) {
        LOG_ERR("Bind failed");
        close(server_sock);
        return;
    }

    if (listen(server_sock, LISTEN_COUNT) < 0) {
        LOG_ERR("Listen failed");
        close(server_sock);
        return;
    }

    LOG_INF("TCP Server listening on port %d", SERVER_PORT);

    while (1) {
        client_sock = accept(server_sock, (struct sockaddr *)&client_addr, &client_addr_len);
        if (client_sock < 0) {
            LOG_ERR("Accept failed");
            continue;
        }

        LOG_INF("Client connected");
        int len = recv(client_sock, recv_buffer, sizeof(recv_buffer) - 1, 0);
        if (len > 0) {
            recv_buffer[len] = '\0';
            LOG_INF("Received: %s", recv_buffer);

			handle_client_request(client_sock, recv_buffer, len);
        }
        // close(client_sock);
    }
}

void create_tcp_server_thread(void) {
	tcp_server_tid = k_thread_create(&tcp_server, tcp_server_thread_stack, 
		TCP_THREAD_STACK_SIZE, tcp_server_thread, NULL, NULL, NULL, 
		TCP_THREAD_PRIORITY, 0, K_NO_WAIT);
	k_thread_name_set(tcp_server_tid, "tcp_server");
}


void kill_tcp_server_thread(void) {
	k_thread_abort(tcp_server_tid);
}



/** TCP client thread used to transparent transport data between tcp server and uart */
K_THREAD_DEFINE(tcp_client_tid, TCP_THREAD_STACK_SIZE,
		tcp_client_thread, NULL, NULL, NULL,
		TCP_THREAD_PRIORITY, 0, 0);

/** TCP server will be create from the tcp client thread */
// K_THREAD_DEFINE(tcp_server_tid, TCP_THREAD_STACK_SIZE, 
// 		tcp_server_thread, NULL, NULL, NULL, 
// 		TCP_THREAD_PRIORITY, 0, 0);
```

## src/uart_handler.c
```c
/*
 * Copyright (c) 2023 Nordic Semiconductor ASA
 *
 * SPDX-License-Identifier: LicenseRef-Nordic-5-Clause
 */

#include <zephyr/kernel.h>
#include <stdio.h>
#include <zephyr/drivers/uart.h>
#include <hal/nrf_uarte.h>
#include <hal/nrf_gpio.h>
#include <zephyr/sys/ring_buffer.h>
#include <zephyr/pm/device.h>

#include <zephyr/logging/log.h>
LOG_MODULE_REGISTER(uart_handler, CONFIG_TCP_LOG_LEVEL);
#include "slip/slip.h"
#include "app.h"
#include "upgrade_app.h"


#define UART_RX_TIMEOUT_US					50000
#define UART_ERROR_DELAY_MS					500
#define UART_RX_EVENT_COUNT_FOR_BUF 		20

#define UART_SLIP_MTU						512

#define UART_SLAB_BLOCK_SIZE 				sizeof(struct rx_buf_t)
#define UART_SLAB_BLOCK_COUNT 				8


const struct device *const uart_dev = DEVICE_DT_GET(DT_NODELABEL(uart0));
uint32_t uart_baudrate;

static struct k_work_delayable rx_process_work;

struct rx_buf_t {
	atomic_t ref_counter;
	size_t len;
	uint8_t buf[512];
};

struct rx_event_t {
	uint8_t *buf;
	size_t len;
};

enum uart_recovery_state {
	RECOVERY_IDLE,
	RECOVERY_ONGOING,
	RECOVERY_DISABLED
};

static atomic_t recovery_state;

bool transfer_mode = false;	//transfer mode flag to indicate now uart will receive image data

static uint8_t slip_buffer[UART_SLIP_MTU];
static slip_t m_slip = {
	.state = SLIP_STATE_DECODING, 
	.p_buffer = slip_buffer,
	.current_index = 0,
	.buffer_len = sizeof(slip_buffer)};

K_MEM_SLAB_DEFINE(rx_slab, UART_SLAB_BLOCK_SIZE, UART_SLAB_BLOCK_COUNT, 4);

K_SEM_DEFINE(tx_done_sem, 0, 1);

K_MSGQ_DEFINE(rx_event_queue, sizeof(struct rx_event_t), 8, 4);

RING_BUF_DECLARE(tx_buf, 256);

/* Protects the tx_buf from multiple writes. */
K_MUTEX_DEFINE(mutex_tx_put); 

static inline struct rx_buf_t *block_start_get(uint8_t *buf)
{
	size_t block_num;

	/* blocks are fixed size units from a continuous memory slab: */
	/* round down to the closest unit size to find beginning of block. */

	block_num = (((size_t)buf - (size_t)rx_slab.buffer) / UART_SLAB_BLOCK_SIZE);

	return (struct rx_buf_t *) &rx_slab.buffer[block_num * UART_SLAB_BLOCK_SIZE];
}

static struct rx_buf_t *rx_buf_alloc(void)
{
	struct rx_buf_t *buf;
	int err;

	/* Async UART driver returns pointers to received data as */
	/* offsets from beginning of RX buffer block. */
	/* This code uses a reference counter to keep track of the number of */
	/* references within a single RX buffer block */

	err = k_mem_slab_alloc(&rx_slab, (void **) &buf, K_NO_WAIT);
	if (err) {
		return NULL;
	}

	atomic_set(&buf->ref_counter, 1);

	return buf;
}

static void rx_buf_ref(void *buf)
{
	atomic_inc(&(block_start_get(buf)->ref_counter));
}

static void rx_buf_unref(void *buf)
{
	struct rx_buf_t *uart_buf = block_start_get(buf);
	atomic_t ref_counter = atomic_dec(&uart_buf->ref_counter);

	/* ref_counter is the uart_buf->ref_counter value prior to decrement */
	if (ref_counter == 1) {
		k_mem_slab_free(&rx_slab, (void *)uart_buf);
	}
}

static int rx_enable(void)
{
	struct rx_buf_t *buf;
	int ret;

	buf = rx_buf_alloc();
	if (!buf) {
		LOG_ERR("UART RX failed to allocate buffer");
		return -ENOMEM;
	}

	ret = uart_rx_enable(uart_dev, buf->buf, sizeof(buf->buf), UART_RX_TIMEOUT_US);
	if (ret) {
		LOG_ERR("UART RX enable failed: %d", ret);
		return ret;
	}

	return 0;
}

// static int rx_disable(void)
// {
// 	int err;

// 	/* Wait for possible rx_enable to complete. */
// 	if (atomic_set(&recovery_state, RECOVERY_DISABLED) == RECOVERY_ONGOING) {
// 		k_sleep(K_MSEC(10));
// 	}

// 	err = uart_rx_disable(uart_dev);
// 	if (err) {
// 		LOG_ERR("UART RX disable failed: %d", err);
// 		atomic_set(&recovery_state, RECOVERY_IDLE);
// 		return err;
// 	}

// 	return 0;
// }

static void rx_recovery(void)
{
	int err;

	if (atomic_get(&recovery_state) != RECOVERY_ONGOING) {
		return;
	}

	err = rx_enable();
	if (err) {
		k_work_schedule(&rx_process_work, K_MSEC(20));
		return;
	}

	atomic_cas(&recovery_state, RECOVERY_ONGOING, RECOVERY_IDLE);
}


static void on_packet_received(uint8_t *buffer, uint16_t length)
{
	int err;
	socket_data_t send_buffer = {0};
	
	send_buffer.data = k_calloc(length+1, sizeof(uint8_t));
	if (send_buffer.data != NULL) 
	{
		memcpy(send_buffer.data, buffer, length);		
		send_buffer.length = length;

		if(0 == k_msgq_num_free_get(&tx_send_queue))
		{
			/* message queue is full ,we have to delete the oldest data to reserve room for the new data */
			socket_data_t data_buffer = {0};
			k_msgq_get(&tx_send_queue, &data_buffer, K_NO_WAIT);
			LOG_DBG("Droped data:[%d]:%s\n",data_buffer.length, data_buffer.data);
			k_free(data_buffer.data);
		}

		/** send the uart data to tcp server*/
		err = k_msgq_put(&tx_send_queue, &send_buffer, K_NO_WAIT);
		if (err) {
			LOG_ERR("Message sent error: %d", err);
			k_free(send_buffer.data);
		}
	} 
	else 
	{
		LOG_ERR("Memory not allocated!\n");
	}
}


/** Before uart send data, the data should be enpacket by SLIP protocol */
void uart_send_data(uint8_t *buffer, uint16_t length)
{
	static uint8_t send_buffer[UART_SLIP_MTU] = {0};
	uint32_t send_length = 0;

	slip_encode(send_buffer, buffer, length, &send_length);
	uart_tx_write(send_buffer, send_length);
}




void handle_uart_data(uint8_t *buffer, uint16_t length)
{
	if(strstr(buffer, "download"))
	{
		// apply_state(CONNECTED);
		apply_state(UPDATE_DOWNLOAD);
	}
	else if(strstr(buffer, "transfer"))
	{
		// apply_state(UPDATE_SERIAL);
		transfer_mode = true;
		dfu_flash_start(0);
		upgrade.total_length = 0;
		upgrade.file_length = fetch_file_length(buffer);
		// LOG_ERR("Received data is not correct, drop it!\n");
	}
	else if(strstr(buffer, "upload:"))
	{
		uint8_t len = 0;
		char *msg = strstr((char *)buffer, "upload:");
		if(msg != NULL)
		{
			msg += strlen("upload:");
			len = length - strlen("upload:");
			on_packet_received(msg, len);
		}
	}
	else if(strstr(buffer, "reboot"))
	{
		apply_state(UPDATE_APPLY);
		// LOG_ERR("Received data is not correct, drop it!\n");
	}
}



static void rx_process(struct k_work *work)
{
	uint16_t i = 0;
	struct rx_event_t rx_event;
	int ret_code = 0;

	while (k_msgq_get(&rx_event_queue, &rx_event, K_NO_WAIT) == 0) 
	{
		/**if we don't use slip protocol, we should use the customized protocol to resolve the received data,
		but current we use the raw data to test aurt upgrade, so we don't need to resolve the received data */
		if(transfer_mode)
		{
			image_data_save(rx_event.buf, rx_event.len);

			if(upgrade.file_length == upgrade.total_length)
			{
				LOG_INF("Download completed!\n");
				apply_state(UPDATE_APPLY);
			}
		}
		else
		{
			//if we use slip protocol, we should decode the received data
			for(i=0; i<rx_event.len; i++)
			{
				ret_code = slip_decode_add_byte(&m_slip, rx_event.buf[i]);
				switch (ret_code)
				{
				case NRF_SUCCESS:
					/** decode uart data success, now put it to message queue */
					// on_packet_received(m_slip.p_buffer, m_slip.current_index);
					LOG_INF("Uart received:[%d]:%s\n",m_slip.current_index, m_slip.p_buffer);
					handle_uart_data(m_slip.p_buffer, m_slip.current_index);		//handle the received data
					
					memset(m_slip.p_buffer, 0, m_slip.buffer_len);
					m_slip.current_index = 0;
					m_slip.state = SLIP_STATE_DECODING;
					break;
				// fall through
				case ERROR_NO_MEM:
					m_slip.current_index = 0;
					m_slip.state = SLIP_STATE_DECODING;
					break;
				default:
					break;
				}
			}
		}
		rx_buf_unref(rx_event.buf);
	}

	rx_recovery();
}

static int tx_start(void)
{
	uint8_t *buf;
	size_t len;
	int err;
	enum pm_device_state state = PM_DEVICE_STATE_OFF;

	pm_device_state_get(uart_dev, &state);
	if (state != PM_DEVICE_STATE_ACTIVE) {
		return 1;
	}

	len = ring_buf_get_claim(&tx_buf, &buf, ring_buf_capacity_get(&tx_buf));
	err = uart_tx(uart_dev, buf, len, SYS_FOREVER_US);
	if (err) {
		LOG_ERR("UART TX error: %d", err);
		ring_buf_get_finish(&tx_buf, 0);
		return err;
	}
	// else
	// {
	// 	LOG_ERR("UART TX [%d] bytes Succeed!", len);
	// }

	return 0;
}

static void uart_callback(const struct device *dev, struct uart_event *evt, void *user_data)
{
	struct rx_buf_t *buf;
	struct rx_event_t rx_event;
	int err;

	ARG_UNUSED(dev);
	ARG_UNUSED(user_data);

	switch (evt->type) {
	case UART_TX_DONE:
	case UART_TX_ABORTED:
		err = ring_buf_get_finish(&tx_buf, evt->data.tx.len);
		if (err) {
			LOG_ERR("UART_TX_%s failure: %d",
				(evt->type == UART_TX_DONE) ? "DONE" : "ABORTED", err);
		}
		if (ring_buf_is_empty(&tx_buf) == false) {
			tx_start();
		} 
		
		k_sem_give(&tx_done_sem);
		break;
	case UART_RX_RDY:
		rx_buf_ref(evt->data.rx.buf);		
		rx_event.buf = &evt->data.rx.buf[evt->data.rx.offset];
		rx_event.len = evt->data.rx.len;
		err = k_msgq_put(&rx_event_queue, &rx_event, K_NO_WAIT);
		if (err) {
			LOG_ERR("UART_RX_RDY failure: %d, dropped: %d", err, evt->data.rx.len);
			rx_buf_unref(evt->data.rx.buf);
			break;
		}
		(void)k_work_submit((struct k_work *)&rx_process_work);
		break;
	case UART_RX_BUF_REQUEST:
		buf = rx_buf_alloc();
		if (!buf) {
			LOG_WRN("Disabling UART RX: No free buffers.");
			break;
		}
		err = uart_rx_buf_rsp(uart_dev, buf->buf, sizeof(buf->buf));
		if (err) {
			LOG_WRN("Disabling UART RX: %d", err);
			rx_buf_unref(buf);
		}
		break;
	case UART_RX_BUF_RELEASED:
		if (evt->data.rx_buf.buf) {
			rx_buf_unref(evt->data.rx_buf.buf);
		}
		break;
	case UART_RX_DISABLED:
		if (atomic_cas(&recovery_state, RECOVERY_IDLE, RECOVERY_ONGOING)) {
			k_work_submit((struct k_work *)&rx_process_work);
		}
		break;
	default:
		break;
	}
}

/* Write the data to tx_buffer and trigger sending. */
int uart_tx_write(const uint8_t *data, size_t len)
{
	size_t ret;
	size_t sent = 0;
	int err;

	k_mutex_lock(&mutex_tx_put, K_FOREVER);
	while (sent < len) {
		ret = ring_buf_put(&tx_buf, data + sent, len - sent);
		if (ret) {
			sent += ret;
		} else {
			/* Buffer full, block and start TX. */
			k_sem_take(&tx_done_sem, K_FOREVER);
			err = tx_start();
			if (err) {
				LOG_ERR("TX buf overflow, %d dropped. Unable to send: %d",
					len - sent,
					err);
				k_sem_give(&tx_done_sem);
				k_mutex_unlock(&mutex_tx_put);
				return err;
			}
		}
	}
	k_mutex_unlock(&mutex_tx_put);

	if (k_sem_take(&tx_done_sem, K_NO_WAIT) == 0) {
		err = tx_start();
		if (err == 1) {
			k_sem_give(&tx_done_sem);
			return 0;
		} else if (err) {
			LOG_ERR("TX start failed: %d", err);
			k_sem_give(&tx_done_sem);
			return err;
		}
	} else {
		/* TX already in progress. */
	}

	return 0;
}

int uart_handler_init(void)
{
	int err;
	uint32_t start_time;
	struct uart_config cfg;

	if (!device_is_ready(uart_dev)) {
		LOG_ERR("UART device not ready");
		return -ENODEV;
	}

	err = uart_config_get(uart_dev, &cfg);
	if (err) {
		LOG_ERR("uart_config_get: %d", err);
		return err;
	}

	uart_baudrate = cfg.baudrate;
	LOG_INF("UART baud: %d d/p/s-bits: %d/%d/%d HWFC: %d",
		cfg.baudrate, cfg.data_bits, cfg.parity,
		cfg.stop_bits, cfg.flow_ctrl);

	/* Wait for the UART line to become valid */
	start_time = k_uptime_get_32();
	do {
		err = uart_err_check(uart_dev);
		if (err) {
			uint32_t now = k_uptime_get_32();

			if (now - start_time > UART_ERROR_DELAY_MS) {
				LOG_ERR("UART check failed: %d", err);
				return -EIO;
			}
			k_sleep(K_MSEC(10));
		}
	} while (err);
	err = uart_callback_set(uart_dev, uart_callback, NULL);
	if (err) {
		LOG_ERR("Cannot set callback: %d", err);
		return -EFAULT;
	}
	(void)atomic_set(&recovery_state, RECOVERY_IDLE);
	err = rx_enable();
	if (err) {
		return -EFAULT;
	}

	k_work_init_delayable(&rx_process_work, rx_process);

	k_sem_give(&tx_done_sem);

	LOG_INF("UART init!\n");

	return 0;
}
```

## src/upgrade_app.c
```c
#include <stdio.h>
#include <stdbool.h>
#include <errno.h>
#include <stdlib.h>
#include <zephyr/posix/fcntl.h>
#include <zephyr/net/socket.h>
#include <zephyr/net/net_ip.h>
#include <zephyr/net/tls_credentials.h>
#include <net/ftp_client.h>
#include <zephyr/kernel.h>
#include <zephyr/dfu/mcuboot.h>
#include <zephyr/sys/reboot.h>
#include <zephyr/logging/log.h>
LOG_MODULE_DECLARE(tcp_sample,CONFIG_TCP_LOG_LEVEL);

#include "upgrade_app.h"
// #include "dfu_lib/nrf_dfu_flash.h"


struct ftp_server_t server;

static struct k_work fota_work;

static enum fota_state state = IDLE;



// uint32_t file_length = 0;	//fetch length of file
// static uint32_t total_length = 0;	//received total length of file
struct image_t upgrade = {0};


int fetch_file_length(const uint8_t *msg)
{
    int bytes;
    
    if (sscanf(msg, "%*[^()](%d bytes)", &bytes) == 1) {
        LOG_INF("Fetch file length: %d\n", bytes);
    } else {
        LOG_WRN("Can not fetch file length\n");
    }
	return bytes;
}

static void ftp_ctrl_callback(const uint8_t *msg, uint16_t len)
{
	char code_str[4];  /* Proprietary code 900 ~ 999 */
	int code;

	strncpy(code_str, msg, sizeof(code_str) - 1);
	code_str[sizeof(code_str) - 1] = '\0';
	code = atoi(code_str);
	if (FTP_PROPRIETARY(code)) 
	{
		switch (code) {
		case FTP_CODE_901:
			LOG_WRN("Disconnected by remote server!\r\n");
			break;
		case FTP_CODE_902:
            LOG_WRN("Connection aborted!\r\n");
			break;
		case FTP_CODE_903:
            LOG_WRN("Socket poll error!\r\n");
			break;
		case FTP_CODE_904:
            LOG_WRN("Unexpected poll event!\"\r\n");
			break;
		case FTP_CODE_905:
			LOG_WRN("Network down!\r\n");
			break;
		default:
			LOG_WRN("Unexpected error!\r\n");
			break;
		}
	
		return;
	}
	else if(FTP_PRELIMINARY_POS(code))
	{
		if(code == FTP_CODE_150)
		{
			upgrade.file_length = fetch_file_length(msg);
			// LOG_INF("File status okay; about to open data connection\r\n");
		}	
	}
}


static int do_ftp_open(struct ftp_server_t *server)
{
    int ret = 0;
    sec_tag_t sec_tag = INVALID_SEC_TAG;

    if (strlen(server->username) == 0) 
    {
        strcpy(server->username, FTP_USER_ANONYMOUS);
        strcpy(server->password, FTP_PASSWORD_ANONYMOUS);
    } 
    else 
    {
         /* FTP open */
        ret = ftp_open(server->hostname, server->port, sec_tag);
        if (ret != FTP_CODE_200) 
        {
            return -ENETUNREACH;
        }

        /* FTP login */
        ret = ftp_login(server->username, server->password);
        if (ret != FTP_CODE_230) 
        {
            return -EACCES;
        }
    }
    
    return 0;
}


static int do_ftp_status(void)
{
	int ret = ftp_status();

	return (ret == FTP_CODE_211) ? 0 : -1;
}

#if 0
static int do_ftp_ls(char *filepath)
{
    int ret;

    ret = ftp_list("-l", filepath);
    if (ret == FTP_CODE_226) 
    {
        return 0;
    } 
    else 
    {
        return -1;
    }
}


static int do_ftp_cd(char *dirpath)
{
	int ret;

	ret = ftp_cwd(dirpath);
	return (ret == FTP_CODE_250) ? 0 : -1;
}
#endif


static int do_ftp_close(void)
{
	int ret = ftp_close();

	return (ret == FTP_CODE_221) ? 0 : -1;
}


static int download_image_file(struct ftp_server_t *server)
{
    int ret;
	// char *file_name = "zephyr.signed.bin";
	char *file_name = "signed_patch.bin";
	// char *file_path = "home";

    // char *file_name = strrchr(server->hostname, '/');
    // if (file_name == NULL) 
    // {
    //     LOG_ERR("Invalid file path\n");
    //     return -ENOENT;
    // }
    // file_name++;

	ret = do_ftp_open(server);
	if (ret) 
	{
		LOG_ERR("Failed to open FTP connection\n");		
		return ret;
	}

	ret = do_ftp_status();
	if (ret)		
	{
		LOG_ERR("Failed to get FTP status\n");		
		return ret;
	}

	// ret = do_ftp_ls(file_name);
	// if (ret)		
	// {
	// 	LOG_ERR("Failed to get FTP status\n");		
	// 	return ret;
	// }

	// ret = do_ftp_cd(file_path);
	// if (ret)		
	// {
	// 	LOG_ERR("Failed to change directory path!\n");		
	// 	return ret;
	// }

    ret = ftp_type(FTP_TYPE_BINARY);
    if (ret != FTP_CODE_200) 
    {
        LOG_ERR("Failed to set binary mode\n");
        return ret;
    }

    ret = ftp_get(file_name);
    if (ret != FTP_CODE_226) 
    {
        LOG_ERR("Failed to download file\n");
        return ret;
    }
    LOG_INF("File downloaded successfully\n");

	return ret;
}


void apply_state(enum fota_state new_state)
{
	// __ASSERT(state != new_state, "State already set: %d", state);		
	state = new_state;

	switch (new_state) {
	case IDLE:
		break;
	case UPDATE_SERIAL:
		//	LOG_INF("Now enter 'transfer' to transfer new application firmware\n");
        k_work_submit(&fota_work);
		LOG_INF("Now enter 'transparent mode' to receive new application firmware through uart!\n");
		break;
	case UPDATE_DOWNLOAD:
		k_work_submit(&fota_work);
		LOG_INF("Now start to download new application firmware\n");
		break;
	case UPDATE_PENDING:
		if(upgrade.total_length >= 0)
		{
			 // state = UPDATE_APPLY;
			LOG_INF("file download succsee, now enter mcuboot!\n");
		}
		else
		{
			state = UPDATE_DOWNLOAD;		//download fiale, reconnect and download again
			LOG_INF("Now enter 'download' to download new application firmware\n");	
		}
		k_work_submit(&fota_work);
		break;
	case UPDATE_APPLY:
		k_work_submit(&fota_work);
		break;
	}
}


static int start_dfu_process(void)
{
	int err = 0;

	upgrade.file_length = 0;
	upgrade.total_length = 0;

	memset(&server, 0, sizeof(server));
	memcpy(server.hostname, CONFIG_FTP_DOWNLOAD_HOST, strlen(CONFIG_FTP_DOWNLOAD_HOST));
	server.port = CONFIG_FTP_DOWNLOAD_PORT;
	memcpy(server.username, CONFIG_FTP_DOWNLOAD_USER, strlen(CONFIG_FTP_DOWNLOAD_USER));
	memcpy(server.password, CONFIG_FTP_DOWNLOAD_PASSWORD, strlen(CONFIG_FTP_DOWNLOAD_PASSWORD));

	err = dfu_flash_start(0);
	if(err)
	{
		LOG_ERR("Failed to init flash: %d", err);
		return err;
	}

	err = download_image_file(&server);
	if (err != FTP_CODE_226) {
		LOG_INF("Download failed, err %d\n", err);
	}
	else
	{
		LOG_INF("FTP received_length=%d	file_length=%d\n", upgrade.total_length, upgrade.file_length);
		if(upgrade.file_length == upgrade.total_length)
		{
			LOG_INF("Download completed!\n");
			apply_state(UPDATE_APPLY);
		}
		else
		{
			// apply_state(UPDATE_DOWNLOAD);
			LOG_INF("File is corrupted, drop it!\n");
		}
	}
	
	err = do_ftp_close();

	return err;
}



static void fota_work_cb(struct k_work *work)
{
	int err;

	ARG_UNUSED(work);

	switch (state) {
	case UPDATE_DOWNLOAD:
		err = start_dfu_process();
		break;
	case UPDATE_APPLY:
        // err = fota_image_apply();
		sys_reboot(SYS_REBOOT_WARM);
		break;
	default:
		break;
	}
}


void image_data_save(uint8_t *data, uint16_t length)
{
	// LOG_HEXDUMP_INF(data, length, "FTP received:");

	upgrade.total_length += length;
	if(length < 708)
	{
		LOG_INF("Received image: data_length=%d	total_length=%d\n", length, upgrade.total_length);
	}
	// LOG_INF("FTP total_length = %d\n", total_length);
	
	int rc = 0;


	if(upgrade.total_length < upgrade.file_length)
	{
		rc = dfu_data_store(data, length, false);
		if(rc != 0)
		{
			LOG_ERR("flash img write fail");
		}
	}
	else
	{
		if(upgrade.file_length > 1024)
		{
			rc = dfu_data_store(data, length, true);
			if(rc != 0)
			{
				LOG_INF("flash img write fail");
			}

			dfu_flash_finish();
		}
	}
}

static void ftp_data_callback(const uint8_t *msg, uint16_t len)
{
	image_data_save((uint8_t *)msg, len);
}


void ftp_client_init(void)
{
	ftp_init(ftp_ctrl_callback, ftp_data_callback);

    k_work_init(&fota_work, fota_work_cb);
}
```

## src/upgrade_app.h
```c
/*
 * Copyright (c) 2018 Nordic Semiconductor ASA
 *
 * SPDX-License-Identifier: LicenseRef-Nordic-5-Clause
 */

#ifndef __UPGRADE_APP_H_
#define __UPGRADE_APP_H_

#include "dfu_lib/nrf_dfu_flash.h"

#define INVALID_SOCKET       -1
#define INVALID_SEC_TAG      -1

#define FTP_USER_ANONYMOUS      "anonymous"
#define FTP_PASSWORD_ANONYMOUS  "anonymous@example.com"
#define FTP_DEFAULT_PORT        21

#define FTP_MAX_URL          128  /** max size of URL string */
#define FTP_MAX_FILEPATH     128  /** max size of filepath string */
#define FTP_MAX_USERNAME     32   /** max size of username in login */
#define FTP_MAX_PASSWORD     32   /** max size of password in login */


enum fota_state { 
    IDLE, 
    UPDATE_SERIAL,  //serial port update
    UPDATE_DOWNLOAD,    //ftp download update
    UPDATE_PENDING, 
    UPDATE_APPLY 
};


struct ftp_server_t {
    char hostname[FTP_MAX_URL];
    uint16_t port;
	char username[FTP_MAX_USERNAME];
	char password[FTP_MAX_PASSWORD];
};


struct image_t {
    uint32_t file_length;	//fetch length of file
    uint32_t total_length;	//received total length of file
};


extern struct image_t upgrade;	

extern void apply_state(enum fota_state new_state);

extern void image_data_save(uint8_t *data, uint16_t length);

extern int fetch_file_length(const uint8_t *msg);

extern void ftp_client_init(void);

#endif
```
